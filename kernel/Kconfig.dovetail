## kernel/Kconfig.dovetail
```kconfig
config DOVETAIL
	bool "Dovetail interface"
	select IRQ_PIPELINE
	select FORCE_COMMIT_MEMORY
	default y
	---help---
	  Activate this option if you want to enable the interface for
	  running a secondary kernel side-by-side with Linux (aka
	  "dual kernel" configuration).

config DOVETAIL_HAVE_HOSTRT
       bool

config DOVETAIL_TRACK_VM_GUEST
	bool
	default y if KVM
```

## kernel/ipipe/Kconfig
```kconfig
config IPIPE
	bool "Interrupt pipeline"
	default y
	---help---
	  Activate this option if you want the interrupt pipeline to be
	  compiled in.

config IPIPE_WANT_CLOCKSOURCE
       bool

config IPIPE_WANT_PTE_PINNING
       bool

config IPIPE_CORE_APIREV
       int
       depends on IPIPE
       default 2
	---help---
	  The API revision level we implement.

config IPIPE_WANT_APIREV_1
       bool

config IPIPE_WANT_APIREV_2
       bool

config IPIPE_TARGET_APIREV
       int
       depends on IPIPE
       default 1 if IPIPE_WANT_APIREV_1
       default 2 if IPIPE_WANT_APIREV_2
       default IPIPE_CORE_APIREV
	---help---
	  The API revision level the we want (must be <=
	  IPIPE_CORE_APIREV).

config IPIPE_HAVE_HOSTRT
       bool

config IPIPE_HAVE_PIC_MUTE
       bool

config IPIPE_HAVE_VM_NOTIFIER
	bool
```
